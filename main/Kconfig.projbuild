## main/Kconfig.projbuild
```kconfig
menu "Switch Configuration"

    menu "Switch 1"
        config SWITCH_1_INPUT_PIN
            int "GPIO Pin for Switch 1 input"
            default 4
            range 0 39
            help
                The GPIO pin number for the input of Switch 1. Default is 4.

        config SWITCH_1_OUTPUT_PIN
            int "GPIO Pin for Switch 1 output"
            default 12
            range 0 39
            help
                The GPIO pin number for the output of Switch 1. Default is 12.
    endmenu

    menu "Switch 2"
        config SWITCH_2_INPUT_PIN
            int "GPIO Pin for Switch 2 input"
            default 5
            range 0 39
            help
                The GPIO pin number for the input of Switch 2. Default is 5.

        config SWITCH_2_OUTPUT_PIN
            int "GPIO Pin for Switch 2 output"
            default 13
            range 0 39
            help
                The GPIO pin number for the output of Switch 2. Default is 13.
    endmenu

    menu "Switch 3"
        config SWITCH_3_INPUT_PIN
            int "GPIO Pin for Switch 3 input"
            default 6
            range 0 39
            help
                The GPIO pin number for the input of Switch 3. Default is 6.

        config SWITCH_3_OUTPUT_PIN
            int "GPIO Pin for Switch 3 output"
            default 18
            range 0 39
            help
                The GPIO pin number for the output of Switch 3. Default is 18.
    endmenu

    menu "Switch 4"
        config SWITCH_4_INPUT_PIN
            int "GPIO Pin for Switch 4 input"
            default 7
            range 0 39
            help
                The GPIO pin number for the input of Switch 4. Default is 7.

        config SWITCH_4_OUTPUT_PIN
            int "GPIO Pin for Switch 4 output"
            default 19
            range 0 39
            help
                The GPIO pin number for the output of Switch 4. Default is 19.
    endmenu

    menu "Switch 5"
        config SWITCH_5_INPUT_PIN
            int "GPIO Pin for Switch 5 input"
            default 3
            range 0 39
            help
                The GPIO pin number for the input of Switch 5. Default is 3.

        config SWITCH_5_OUTPUT_PIN
            int "GPIO Pin for Switch 5 output"
            default 20
            range 0 39
            help
                The GPIO pin number for the output of Switch 5. Default is 20.
    endmenu

    menu "Switch 6"
        config SWITCH_6_INPUT_PIN
            int "GPIO Pin for Switch 6 input"
            default 2
            range 0 39
            help
                The GPIO pin number for the input of Switch 6. Default is 2.

        config SWITCH_6_OUTPUT_PIN
            int "GPIO Pin for Switch 6 output"
            default 21
            range 0 39
            help
                The GPIO pin number for the output of Switch 6. Default is 21.
    endmenu

    menu "Switch 7"
        config SWITCH_7_INPUT_PIN
            int "GPIO Pin for Switch 7 input"
            default 10
            range 0 39
            help
                The GPIO pin number for the input of Switch 7. Default is 10.

        config SWITCH_7_OUTPUT_PIN
            int "GPIO Pin for Switch 7 output"
            default 22
            range 0 39
            help
                The GPIO pin number for the output of Switch 7. Default is 22.
    endmenu

    menu "Switch 8"
        config SWITCH_8_INPUT_PIN
            int "GPIO Pin for Switch 8 input"
            default 11
            range 0 39
            help
                The GPIO pin number for the input of Switch 8. Default is 11.

        config SWITCH_8_OUTPUT_PIN
            int "GPIO Pin for Switch 8 output"
            default 23
            range 0 39
            help
                The GPIO pin number for the output of Switch 8. Default is 23.
    endmenu

    menu "Other"
        choice
            prompt "Switch Input Mode"
            default SWITCH_INPUT_MODE_TOGGLE
            help
                Select the switch input mode.

            config SWITCH_INPUT_MODE_TOGGLE
                bool "Toggle"

            config SWITCH_INPUT_MODE_PUSHBUTTON
                bool "Pushbutton"
        endchoice

        config GPIO_INDICATOR_LED
            int "GPIO Pin for Indicator LED"
            default 2
            range 0 39
            help
                The GPIO pin number for the onboard or external indicator LED. Default is 2.
    endmenu

endmenu
```
